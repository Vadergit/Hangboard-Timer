/*
 * Rui Santos 
 * Complete Project Details https://randomnerdtutorials.com
 https://randomnerdtutorials.com/esp32-esp8266-publish-sensor-readings-to-google-sheets/
 */

#ifdef ESP32
#include <WiFi.h>
#else
#include <ESP8266WiFi.h>
#endif
#include <WiFiUdp.h>
#include <Adafruit_SSD1327.h>
// Used for I2C or SPI
#define OLED_RESET -1

// I2C
Adafruit_SSD1327 display(128, 128, &Wire, OLED_RESET, 500000);

#include <NTPClient.h>

//NTC Time

const long utcOffsetInSeconds = 7200;


char daysOfTheWeek[7][12] = { "Sunday", "Monday", "Tuesday", "Wednesday", "Thursday", "Friday", "Saturday" };

// Define NTP Client to get time
WiFiUDP ntpUDP;
NTPClient timeClient(ntpUDP, "pool.ntp.org", utcOffsetInSeconds);
int dayofmonth = 0;

//Timer
int s, ms;
unsigned long start, finished, elapsed;

unsigned long millis();
unsigned long previusMillis2 = 0;
unsigned long previusMillis3 = 0;
int state = 0;
unsigned long previousMillis = 0;
unsigned long guestT, darioT, anitaT;
unsigned long guestTd, darioTd, anitaTd;




int user = 0;



// Replace with your SSID and Password
//const char* ssid = "Robo";
//const char* password = "00000000";

const char* ssid = "Sunrise_2.4GHz_9BD0A0";
const char* password = "2zujudb344HC";

// Replace with your unique IFTTT URL resource
const char* resource = "/trigger/hangboard_event/with/key/ndIFb9X0T8pyRO4Wgkbt_O9vkjrAP9XpdnCgAX2V9Qe";

// How your resource variable should look like, but with your own API KEY (that API KEY below is just an example):
//const char* resource = "/trigger/bme280_readings/with/key/nAZjOphL3d-ZO4N3k64-1A7gTlNSrxMJdmqy3";

// Maker Webhooks IFTTT
const char* server = "maker.ifttt.com";





//Button
unsigned long lastDebounceTime = 0;  // the last time the output pin was toggled
unsigned long debounceDelay = 2;     // the debounce time; increase if the output flickers
int lastButtonState = LOW;
int buttonState;  // current state of the button


//Created with online webtool from http://www.majer.ch/lcd/adf_bitmap.php  https://javl.github.io/image2cpp/

// 'images', 37x84px
const unsigned char boulderimages[] PROGMEM = {
  0x00, 0x00, 0x00, 0x00, 0x18, 0x00, 0x00, 0x00, 0x00, 0x78, 0x00, 0x00, 0x00, 0x00, 0xf8, 0x00,
  0x00, 0x00, 0x07, 0xf8, 0x00, 0x00, 0x00, 0x07, 0xf8, 0x00, 0x00, 0x00, 0x07, 0xf8, 0x00, 0x00,
  0x00, 0x0f, 0xf8, 0x00, 0x00, 0x00, 0x0f, 0xf8, 0x00, 0x00, 0x00, 0x1f, 0xf8, 0x00, 0x00, 0x00,
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  0x00, 0x00, 0x00, 0x00
};

// Array of all bitmaps for convenience. (Total bytes used to store images in PROGMEM = 272)
const int boulderallArray_LEN = 1;
const unsigned char* boulderallArray[1] = {
  boulderimages
};


const unsigned char bitmap[] PROGMEM = {
  0x00, 0x00, 0x00, 0x00, 0x00, 0x00, 0x00, 0x00, 0x00, 0x00, 0x00, 0x00, 0x00, 0x00, 0x00, 0x00,
  0x00, 0x00, 0x00, 0x00, 0x00, 0x00, 0x00, 0x00, 0x00, 0x00, 0x00, 0x00, 0x00, 0x00, 0x00, 0x00,
  0x00, 0x00, 0x00, 0x00, 0x00, 0x00, 0x00, 0x00, 0x00, 0x00, 0x00, 0x00, 0x00, 0x00, 0x00, 0x00,
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  0x00, 0x00, 0x00, 0x00, 0x00, 0x00, 0x00, 0x00, 0x00, 0x00, 0x00, 0x00, 0x00, 0x00, 0x00, 0x00
};









void setup() {
  Serial.begin(115200);

  pinMode(D6, INPUT_PULLUP);
  pinMode(D7, INPUT_PULLUP);




  if (!display.begin(0x3D)) {
    Serial.println("Unable to initialize OLED");
    while (1) yield();
  }
  display.clearDisplay();
  delay(200);
  // display.invertDisplay(true);
  display.drawBitmap(0, 0, bitmap, 128, 128, 46);


  display.setTextSize(2);  // Draw 2X-scale text
  display.setTextColor(SSD1327_BLACK);

  display.setTextSize(1);
  display.setCursor(30, 10);
  display.println("Hangboard Time ");

  display.display();

  initWifi();
  delay(2000);
}

void loop() {
  display.clearDisplay();
  User();



  display.drawBitmap(91, 0, boulderimages, 37, 84, 46);

  display.setTextColor(SSD1327_WHITE);
  display.setTextSize(1);
  display.setCursor(0, 10);
  display.println("Hangboard Time ");


  display.setTextSize(1);

  unsigned long over;

  elapsed = guestTd - start;
  over = elapsed % 3600000;
  over = over % 60000;
  s = int(over / 1000);
  ms = over % 1000;
  display.setCursor(0, 30);
  display.print("Guest:");

  display.print(guestT / 60000);
  display.print("min ");
  display.print(s);
  display.print("s ");
  // display.print(ms);
  //display.print("ms");



  elapsed = anitaTd - start;
  over = elapsed % 3600000;
  over = over % 60000;
  s = int(over / 1000);
  ms = over % 1000;
  display.setCursor(0, 40);
  display.print("Anita:");

  display.print(anitaTd / 60000);
  display.print("min ");
  display.print(s);
  display.print("s ");
  // display.print(ms);
  // display.print("ms");

  elapsed = darioTd - start;
  over = elapsed % 3600000;
  over = over % 60000;
  s = int(over / 1000);
  ms = over % 1000;
  display.setCursor(0, 50);
  display.print("Dario:");
  display.print(darioTd / 60000);
  display.print("min ");
  display.print(s);
  display.print("s ");
  // display.print(ms);
  //display.print("ms");

  //unsigned long over;
  elapsed = finished - start;
  over = elapsed % 3600000;
  over = over % 60000;
  s = int(over / 1000);
  ms = over % 1000;
  display.setTextSize(2);
  display.setCursor(0, 110);
  display.print(s);
  display.print("s ");
  display.print(ms);
  display.print("ms");


  display.setTextSize(1);
  display.setCursor(0, 90);
  display.println("user: ");

  display.display();
}

// Establish a Wi-Fi connection with your router
void initWifi() {
  Serial.print("Connecting to: ");
  Serial.print(ssid);
  WiFi.begin(ssid, password);

  int timeout = 10 * 4;  // 10 seconds
  while (WiFi.status() != WL_CONNECTED && (timeout-- > 0)) {
    //  while(WiFi.status() != WL_CONNECTED ) {
    delay(250);
    Serial.print(".");
  }
  Serial.println("");

  if (WiFi.status() != WL_CONNECTED) {
    Serial.println("Failed to connect, going back to sleep");
  }

  Serial.print("WiFi connected in: ");
  Serial.print(millis());
  Serial.print(", IP address: ");
  Serial.println(WiFi.localIP());
}

// Make an HTTP request to the IFTTT web service
void makeIFTTTRequest() {
  Serial.print("Connecting to ");
  Serial.print(server);

  WiFiClient client;
  int retries = 5;
  while (!!!client.connect(server, 80) && (retries-- > 0)) {
    Serial.print(".");
  }
  Serial.println();
  if (!!!client.connected()) {
    Serial.println("Failed to connect...");
  }

  Serial.print("Request resource: ");
  Serial.println(resource);

  // Webhook Vairables
  String jsonObject = String("{\"value1\":\"") + (guestT) + "\",\"value2\":\"" + (anitaT)
                      + "\",\"value3\":\"" + (darioT) + "\"}";

  client.println(String("POST ") + resource + " HTTP/1.1");
  client.println(String("Host: ") + server);
  client.println("Connection: close\r\nContent-Type: application/json");
  client.print("Content-Length: ");
  client.println(jsonObject.length());
  client.println();
  client.println(jsonObject);

  int timeout = 5 * 10;  // 5 seconds
  while (!!!client.available() && (timeout-- > 0)) {
    delay(100);
  }
  if (!!!client.available()) {
    Serial.println("No response...");
  }
  while (client.available()) {
    Serial.write(client.read());
  }

  Serial.println("\nclosing connection");
  client.stop();
}


void daycheck() {
  timeClient.update();

  if (timeClient.getDay() != dayofmonth) {
    dayofmonth = timeClient.getDay();
    Serial.println("day has changed");

    guestTd = 0;
    anitaTd = 0;
    darioTd = 0;
  }
}


void User() {
  int reading = digitalRead(D7);
  if (reading != lastButtonState) {
    // reset the debouncing timer
    lastDebounceTime = millis();

    //Serial.println("1");
  }

  if ((millis() - lastDebounceTime) > debounceDelay) {
    // whatever the reading is at, it's been there for longer than the debounce
    // delay, so take it as the actual current state:

    // if the button state has changed:
    if (reading != buttonState) {
      buttonState = reading;

      //Serial.println("2");


      if (buttonState == LOW) {
        // Serial.println("3");
        user = user + 1;
        finished = 0;
      }
    }
  }
  lastButtonState = reading;

  switch (user) {
    case 0:  // your hand is on the sensor
      //Serial.println("Guest");


      // Time Management Timer
      if (digitalRead(D6) == LOW) {
        unsigned long currentMillis = millis();
        previusMillis2 = (currentMillis - previousMillis);

        finished = previusMillis2;
      }

      if (digitalRead(D6) == HIGH) {

        previousMillis = millis();
        if (previusMillis3 != previusMillis2) {
          guestTd += finished;
          guestT = finished;
          makeIFTTTRequest();
          guestT = 0;

          //Serial.print("guestT: ");
          // Serial.println(guestT);
          previusMillis3 = previusMillis2;
        }
      }

      display.setTextSize(2);
      display.setCursor(30, 85);
      display.println("Guest ");


      break;
    case 1:  // your hand is close to the sensor

      if (digitalRead(D6) == LOW) {
        unsigned long currentMillis = millis();
        previusMillis2 = (currentMillis - previousMillis);  ///

        finished = previusMillis2;
      }

      if (digitalRead(D6) == HIGH) {

        previousMillis = millis();
        if (previusMillis3 != previusMillis2) {
          anitaTd += finished;
          anitaT = finished;
          makeIFTTTRequest();
          anitaT = 0;

          // Serial.print("anitaT: ");
          // Serial.println(anitaT);
          previusMillis3 = previusMillis2;
        }
      }

      display.setTextSize(2);
      display.setCursor(30, 85);
      display.println("Anita ");


      break;
    case 2:
      // Time Management Timer
      if (digitalRead(D6) == LOW) {
        unsigned long currentMillis = millis();
        previusMillis2 = (currentMillis - previousMillis);  ///

        finished = previusMillis2;
      }

      if (digitalRead(D6) == HIGH) {

        previousMillis = millis();
        if (previusMillis3 != previusMillis2) {
          darioTd += finished;

          darioT = finished;
          makeIFTTTRequest();
          darioT = 0;
          previusMillis3 = previusMillis2;
        }
      }
      display.setTextSize(2);
      display.setCursor(30, 85);
      display.print("Dario ");


      break;

    case 3:  // your hand is a few inches from the sensor
      //Serial.println("");
      user = 0;
  }
}
